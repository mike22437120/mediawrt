## packages/multimedia/tvheadend/Config.in
```kconfig
config TVHEADEND_AVAHI_SUPPORT
	bool "Avahi client support"
	select PACKAGE_libavahi-client
	default n
```

## packages/multimedia/xbmc/Config.in
```kconfig
config XBMC_NONFREE
	bool "Enable non-free components (rar, ccx, ffmpeg)"
	default n

config XBMC_DVDCSS
	bool "DVD CSS support"
	default n

config XBMC_FAAC
	bool "FAAC support"
	default n

config XBMC_AVAHI
	bool "Enable Avahi support"
	default n

config XBMC_WEBSERVER
	bool "Build Internal Webserver"
	select PACKAGE_libmicrohttpd
	default n

config XBMC_VDPAU
	bool "Enable VDPAU support"
	select PACKAGE_libvdpau
	default n

config XBMC_VAAPI
	bool "VAAPI support"
	default n

config XBMC_CRYSTALHD
	bool "CRYSTALHD support"
	default n
	
config XBMC_BLURAY
	bool "BluRay support"
	select PACKAGE_libbluray
	default n
	
config XBMC_RTMP
	bool "RTMP support via librtmp"
	select PACKAGE_rtmpdump
	default n	
	
config XBMC_PULSEAUDIO
	bool "Enable PulseAudio support"
	default n

config XBMC_HAL
	bool "Enable HAL support"
	default n

config XBMC_OPENGL
	bool "Enable OpenGL support"
	select SDL_VIDEO_OPENGL
	default y
	
CONFIG_XBMC_XRANDR	
	bool "Enable XRandr"
	select SDL_VIDEO_X11_XRANDR
	default y
```
